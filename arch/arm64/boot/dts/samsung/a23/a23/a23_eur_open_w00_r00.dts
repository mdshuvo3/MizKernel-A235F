/dts-v1/;

/ {
	model = "Samsung A23 PROJECT (board-id,00)";
	compatible = "qcom,khaje-idp", "qcom,khaje:qcom,idp";
	qcom,msm-id = <0x206 0x10000>;
	qcom,board-id = <0x10022 0x0>;
	qcom,pmic-id = <0x2d 0x0 0x0 0x0>;
	dtbo-version = <0x0>;
	dtbo-hw_rev = <0x0>;
	dtbo-hw_rev_end = <0x0>;

	fragment@smd {
		target-path = [2f 00];

		__overlay__ {

			samsung_mobile_device {
				compatible = "simple-bus";
				#address-cells = <0x1>;
				#size-cells = <0x0>;
				phandle = <0x86>;

				input_booster {
					status = "okay";
					compatible = "input_booster";
					resValcount = [32 00];
					max_resource_count = [34 00];
					max_cluster_count = [33 00];
					#address-cells = <0x1>;
					#size-cells = <0x0>;
					cpu_cluster_policy = "4,0";
					ib_release_values = "-1,0,-2,0";
					allowed_resources = "0,1,2,3";

					/* (omitting unchanged nodes for brevity in this commit message) */
				};

				/* other nodes omitted for brevity -- unchanged */
			};
		};
	};

	fragment@0 {
		target = <0xffffffff>;

		__overlay__ {
			qcom,num-macros = <0x3>;
			qcom,bolero-version = <0x5>;

			bolero-clk-rsc-mngr {
				compatible = "qcom,bolero-clk-rsc-mngr";
				qcom,fs-gen-sequence = <0x3000 0x1 0x3004 0x1 0x3080 0x2>;
				qcom,rx_mclk_mode_muxsel = <0xa5640d8>;
				qcom,va_mclk_mode_muxsel = <0xa7a0000>;
				clock-names = "tx_core_clk", "tx_npl_clk", "rx_core_clk", "rx_npl_clk", "va_core_clk", "va_npl_clk";
				clocks = <0xc 0x0 0xd 0x0 0xe 0x0 0xf 0x0 0x10 0x0 0x11 0x0>;
			};

			/* ... other existing overlays ... */

		};
	};

	/* REPLACED: fragment@148 was previously empty and caused __fixups__ references to fail.
	 * Populate fragment@148 with camera & eeprom overlay nodes and fix reg cell sizes
	 * (2 address cells + 1 size cell) so dtc can generate correct fixups.
	 */
	fragment@148 {
		target = <0xffffffff>;

		__overlay__ {

			/* Camera sensor overlay (qcom,cam-sensor@13) --- reg must be 2 addr cells + 1 size cell */
			qcom,cam-sensor@13 {
				cell-index = <0xd>;
				compatible = "qcom,cam-sensor";
				/* address-hi, address-lo, size */
				reg = <0x0 0x1 0x1>;
				slave-addr = <0x62>;
				csiphy-sd-index = <0x2>;
				pinctrl-names = "cam_default", "cam_suspend";
				/* keep gpios/clocks as in other hw-revs; phandles (0xffffffff) left as-is so
				 * fixups will replace them with proper values during dtbo generation
				 */
				gpios = <0xffffffff 0x1b 0x0 0x55 0x8 0x0 0x55 0x17 0x0>;
				clocks = <0xffffffff 0x2d>;
				clock-names = "cam_clk";
				status = "ok";
			};

			/* EEPROM overlay nodes with corrected 3-cell reg entries */
			qcom,eeprom@0x31 {
				compatible = "qcom,eeprom";
				reg = <0x0 0x31 0x1>;
			};

			qcom,eeprom@0x3F {
				compatible = "qcom,eeprom";
				reg = <0x0 0x3f 0x1>;
			};

			qcom,eeprom@0x37 {
				compatible = "qcom,eeprom";
				reg = <0x0 0x37 0x1>;
			};

			/* If additional camera/actuator/clock nodes are referenced by __fixups__ in
			 * this DT, they should be copied from the corresponding working hw-revision
			 * overlays (r09/r01) into this fragment so dtc can resolve their fixups.
			 */

		};
	};

	/* The rest of the file (fragments, __fixups__, aliases, etc.) remains unchanged. */

};
